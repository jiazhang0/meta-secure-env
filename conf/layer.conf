## conf/layer.conf
```bitbake
#
# Copyright (C) 2016-2017 Wind River Systems, Inc.
#

# We have a conf and classes directory, add to BBPATH
BBPATH =. "${LAYERDIR}:"

# We have a packages directory, add to BBFILES
BBFILES += "${LAYERDIR}/recipes-*/*/*.bb \
        ${LAYERDIR}/recipes-*/*/*.bbappend"

BBFILE_COLLECTIONS += "meta-secure-env"
BBFILE_PATTERN_meta-secure-env = "^${LAYERDIR}/"
BBFILE_PRIORITY_meta-secure-env = "7"

# This should only be incremented on significant changes that will
# cause compatibility issues with other layers
LAYERVERSION_meta-secure-env = "1"

LAYER_PATH_meta-secure-env = "${LAYERDIR}"

LAYERDEPENDS_meta-secure-env = "\
    meta-efi-secure-boot \
    meta-encrypted-storage \
    meta-integrity \
    meta-signing-key \
    measured \
"
```
